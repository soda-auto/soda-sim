VERSION "HIPBNYYYYYYYYYYYYYYYYYYYYYYYYYYYYYYYYYYYYY/4/%%%/4/'%**4YYY///"

NS_ :

BS_:

BU_: VCU RMC

BO_ 331 VCU_State: 8 Vector__XXX
 SG_ VCU_TurnLightState : 2|2@1+ (1,0) [0|3] "" Vector__XXX
 SG_ VCU_DriverTurnLightReq : 0|2@1+ (1,0) [0|3] "" Vector__XXX

BO_ 330 RMC_VCU_Request: 8 Vector__XXX
 SG_ RMC_TurnLightReq : 2|2@1+ (1,0) [0|3] "" Vector__XXX
 SG_ RMC_HornReq : 0|2@1+ (1,0) [0|3] "" Vector__XXX

BA_DEF_ BO_  "GenMsgCycleTime" INT 0 1000;
BA_DEF_  "BusType" STRING ;
BA_DEF_DEF_  "GenMsgCycleTime" 0;
BA_DEF_DEF_  "BusType" "CAN";
BA_ "GenMsgCycleTime" BO_ 331 100;
BA_ "GenMsgCycleTime" BO_ 330 100;
VAL_ 331 VCU_TurnLightState 3 "Emergency" 2 "Right" 1 "Left" 0 "None" ;
VAL_ 331 VCU_DriverTurnLightReq 3 "Emergency" 2 "Right" 1 "Left" 0 "None" ;
VAL_ 330 RMC_TurnLightReq 3 "Emergency" 2 "Right" 1 "Left" 0 "None" ;
VAL_ 330 RMC_HornReq 1 "Horn On" 0 "Horn Off" ;
